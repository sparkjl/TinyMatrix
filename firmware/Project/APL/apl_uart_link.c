#include "includes.h"

//#define CRC16_BUYPASS      1
#define CRC16_MODBUS       2

#ifdef CRC16_BUYPASS
/* CRC-16/BUYPASS width=16 poly=0x8005 init=0x0000 refin=false refout=false xorout=0x0000 */

static const uint16_t crc16_table[256] = {
0x0000,0x8005,0x800F,0x000A,0x801B,0x001E,0x0014,0x8011,
0x8033,0x0036,0x003C,0x8039,0x0028,0x802D,0x8027,0x0022,
0x8063,0x0066,0x006C,0x8069,0x0078,0x807D,0x8077,0x0072,
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0x8213,0x0216,0x021C,0x8219,0x0208,0x820D,0x8207,0x0202
};

uint16_t crc16_create(uint8_t *p_data, uint16_t len)
{
  uint8_t temp = 0;
  uint16_t crc_code = 0;

  while(len--)
  {
    temp = (uint8_t)(crc_code >> 8);
    crc_code <<= 8;
    crc_code ^= crc16_table[temp ^ *p_data];
    p_data++;
  }

  return crc_code;
}

void crc16_fill(uint8_t *p_data, uint16_t len)
{
  uint16_t crc_code = 0;

  if(len < 2)
    return;

  crc_code = crc16_create(p_data, len-2);

  p_data[len-1] = crc_code & 0xff;
  p_data[len-2] = (crc_code >> 8) & 0xff;
}

#elif CRC16_MODBUS
/* CRC-16/MODBUS width=16 poly=0x8005 init=0xffff refin=true refout=true xorout=0x0000 */

static const uint16_t crc16_table[256] = {
0x0000,0xc0c1,0xc181,0x0140,0xc301,0x03c0,0x0280,0xc241,
0xc601,0x06c0,0x0780,0xc741,0x0500,0xc5c1,0xc481,0x0440,
0xcc01,0x0cc0,0x0d80,0xcd41,0x0f00,0xcfc1,0xce81,0x0e40,
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0x8201,0x42c0,0x4380,0x8341,0x4100,0x81c1,0x8081,0x4040
};

uint16_t crc16_create(uint8_t *p_data, uint16_t len)
{
  uint8_t temp = 0;
  uint16_t crc_code = 0xffff;

  while(len--)
  {
    temp = (uint8_t)(crc_code & 0xff);
    crc_code >>= 8;
    crc_code ^= crc16_table[temp ^ *p_data];
    p_data++;
  }

  return crc_code;
}

void crc16_fill(uint8_t *p_data, uint16_t len)
{
  uint16_t crc_code = 0;

  if(len < 2)
    return;

  crc_code = crc16_create(p_data, len-2);

  p_data[len-1] = (crc_code >> 8) & 0xff;
  p_data[len-2] = crc_code & 0xff;
}

#else

#endif


UartLink_HandleTypeDef ulink;

uint8_t apl_ulink_handle(void)
{
  uint8_t status = 0;
  uint16_t crc_code = 0;

  if(uart1.rx_state == UART_OVER)
  {

    ulink.addr = uart1.rx_buff[0];
    ulink.func = uart1.rx_buff[1];
    ulink.tick = uart1.rx_buff[2];
    ulink.length = uart1.rx_buff[3];

    for(uint16_t i=0; i<ulink.length; i++)
    {
      ulink.data[i] = uart1.rx_buff[4+i];
    }

    ulink.crc16[0] = uart1.rx_buff[ulink.length+4];
    ulink.crc16[1] = uart1.rx_buff[ulink.length+5];

    api_uart_rx_start(&uart1);

    crc_code = crc16_create((uint8_t *)&ulink, ulink.length+4);

    if((ulink.crc16[0] == (crc_code & 0xff)) && (ulink.crc16[1] == (crc_code >> 8)))
    {
      status = 1;
      if(ulink.addr == 0x01)
      {
        status = 2;
        switch(ulink.func)
        {
          case 0:
            break;

          case 1:
            apl_font_upgrade(ulink.data, ulink.length);
            break;

          case 2:
            strcpy((char*)sys_data.font_text[0], (char*)ulink.data);
            break;

          default:
            break;
        }

        if(ulink.func == 1)
        {
          uart1.tx_buff[0] = ulink.addr;
          uart1.tx_buff[1] = ulink.func;
          uart1.tx_buff[2] = ulink.tick;
          uart1.tx_buff[3] = ulink.length = 0;

          crc16_fill(uart1.tx_buff, 6);
          api_uart_tx_start(&uart1, uart1.tx_buff, 6);
        }
        else
        {
          uart1.tx_buff[0] = ulink.addr;
          uart1.tx_buff[1] = ulink.func;
          uart1.tx_buff[2] = ulink.tick;
          uart1.tx_buff[3] = ulink.length;

          for(uint16_t i=0; i<ulink.length; i++)
          {
            uart1.tx_buff[4+i] = ulink.data[i];
          }

          crc16_fill(uart1.tx_buff, ulink.length+6);
          api_uart_tx_start(&uart1, uart1.tx_buff, ulink.length+6);
        }
      }
    }
  }

  return status;
}

